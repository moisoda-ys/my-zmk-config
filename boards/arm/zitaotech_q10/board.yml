## boards/shields/zitaotech_q10/Kconfig.zitaotech_q10
```kconfig
# Copyright (c) 2026 ZitaoTech
# SPDX-License-Identifier: Apache-2.0

config BOARD_ZITAOTECH_Q10
    select SOC_NRF52840_QIAA
    select ZMK_BOARD_COMPAT if BOARD_ZITAOTECH_Q10
    imply RETAINED_MEM if BOARD_ZITAOTECH_Q10
    imply RETENTION if BOARD_ZITAOTECH_Q10
    imply RETENTION_BOOT_MODE if BOARD_ZITAOTECH_Q10

choice ZMK_BOOTMODE_MAGIC_VALUE_BOOTLOADER_TYPE
    default ZMK_BOOTMODE_MAGIC_VALUE_BOOTLOADER_TYPE_ADAFRUIT_NRF52

endchoice

menu "A320 Trackpad Setting"

config A320_TRACKPAD_SCROLL_INTERVAL
    int "Trackpad scroll in miliseconds"
    default 50
    range 0 200
    help
      The bigger this value, the slower the trackpad scrolls

config A320_LOG_LEVEL
	int "Log Level for Touch"
	default 4

config A320
	bool "A320 Driver"
	depends on I2C && GPIO
	help
	  Projected capacitive trackpad/touchscreen controller.

config INPUT_A320_INIT_PRIORITY
  int "A320 Initialization Priority"
  default 90


config A320_TRACKPAD_SPEEDMULTIPLIER_VERTICAL
    int "Trackpad speed multiplier y"
    default 100
    range 1 100
    help
      from 1 to 100

config A320_TRACKPAD_SPEEDMULTIPLIER_HORIZONTAL
    int "Trackpad speed multiplier x"
    default 100
    range 1 100
    help
      from 1 to 100
      
endmenu
```
