## boards/arm/sofle_dongle/board.yml
```yaml
board:
  name: sofle_dongle
  full_name: Sofle Dongle
  vendor: zitaotech
  socs:
    - name: nrf52840
  variants:
    - name: sofle_dongle_left
      qualifier: nrf52840
    - name: sofle_dongle_right
      qualifier: nrf52840
```

## boards/arm/zitaotech_q10/Kconfig.board
```kconfig
# Copyright (c) 2025 ZitaoTech
# SPDX-License-Identifier: MIT

config BOARD_ZITAOTECH_Q10
    bool "zitaotech q10"
    depends on SOC_NRF52840_QIAA
```

## boards/shields/sofle_dongle/Kconfig.board
```kconfig
# Copyright (c) 2025 ZitaoTech
# SPDX-License-Identifier: MIT

config BOARD_SOFLE_DONGLE
	bool
	depends on SOC_NRF52840_QIAA

config BOARD_SOFLE_DONGLE_LEFT
	bool
	depends on SOC_NRF52840_QIAA

config BOARD_SOFLE_DONGLE_RIGHT
	bool
	depends on SOC_NRF52840_QIAA


config A320_TRACKPAD_SCROLL_INTERVAL
    int "Trackpad scroll in miliseconds"
    default 50
    range 0 200
    help
      The bigger this value, the slower the trackpad scrolls

config A320_LOG_LEVEL
	int "Log Level for Touch"
	default 4

config A320
	bool "A320 Driver"
	depends on I2C && GPIO
	help
	  Projected capacitive trackpad/touchscreen controller.

config INPUT_A320_INIT_PRIORITY
  int "A320 Initialization Priority"
  default 90

endmenu
```

## boards/shields/zitaotech_q10/Kconfig.board
```kconfig
# Copyright (c) 2025 ZitaoTech
# SPDX-License-Identifier: MIT

config BOARD_ZITAOTECH_Q10
	bool
	depends on SOC_NRF52840_QIAA
```

## boards/shields/zitaotech_q10/Kconfig.defconfig
```kconfig
# Copyright (c) 2026 ZitaoTech
# SPDX-License-Identifier: MIT

if BOARD_ZITAOTECH_Q10


config ZMK_KEYBOARD_NAME
    default "ZitaoTech_q10"

if USB_DEVICE_STACK

config USB_NRFX
    default y

endif # USB_DEVICE_STACK

if ZMK_BACKLIGHT

config PWM
    default y

config LED_PWM
    default y

endif # ZMK_BACKLIGHT

config BT_CTLR
    default BT

endif # BOARD_ZITAOTECH_Q10


if BOARD_ZITAOTECH_Q10_PERIPHERAL

config ZMK_KEYBOARD_NAME
    default "ZitaoTech_q10_peripheral"

config ZMK_SPLIT
    default y

config ZMK_SPLIT_ROLE_PERIPHERAL
    default y

config ZMK_SPLIT_PERIPHERAL_HID_INDICATORS
    default y

if USB_DEVICE_STACK

config USB_NRFX
    default y

endif # USB_DEVICE_STACK

if ZMK_BACKLIGHT

config PWM
    default y

config LED_PWM
    default y

endif # ZMK_BACKLIGHT

config BT_CTLR
    default BT

endif # BOARD_ZITAOTECH_Q10_PERIPHERAL
```

## config/west.yml
```yaml
manifest:
  version: "1.0"
  projects:
    - name: zmk
      remote: zmkfirmware
      revision: main
      import: app/west.yml
  remotes:
    - name: zmkfirmware
      url-base: https://github.com/zmkfirmware
```
